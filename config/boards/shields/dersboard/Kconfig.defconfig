## config/boards/shields/dersboard/Kconfig.defconfig
```kconfig
if SHIELD_DERSBOARD_LEFT

config ZMK_KEYBOARD_NAME
    default "DersBoard"

config ZMK_SPLIT_ROLE_CENTRAL
    default y

endif

if SHIELD_DERSBOARD_LEFT || SHIELD_DERSBOARD_RIGHT

config ZMK_SPLIT
    default y

endif
```

## config/boards/shields/dersboard/Kconfig.shield
```kconfig
config SHIELD_DERSBOARD_LEFT
    def_bool $(shields_list_contains,dersboard_left)

config SHIELD_DERSBOARD_RIGHT
    def_bool $(shields_list_contains,dersboard_right)
```
